## meta-qemu-edu/conf/layer.conf
```bitbake
# SPDX-License-Identifier: MIT

BBPATH .= ":${LAYERDIR}"

BBFILES += "${LAYERDIR}/recipes-*/*/*.bb \
            ${LAYERDIR}/recipes-*/*/*.bbappend"

BBFILE_COLLECTIONS += "qemuedu"
BBFILE_PATTERN_qemuedu = "^${LAYERDIR}/"
BBFILE_PRIORITY_qemuedu = "8"

LAYERSERIES_COMPAT_qemuedu = "wrynose"
```
